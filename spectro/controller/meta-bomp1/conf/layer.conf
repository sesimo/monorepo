## spectro/controller/meta-bomp1/conf/layer.conf
```bitbake
BBPATH .= ":${LAYERDIR}"

BBFILES += "${LAYERDIR}/recipes-*/*/*.bb ${LAYERDIR}/recipes-*/*/*.bbappend"

BBFILE_COLLECTIONS += "bomp1"
BBFILE_PATTERN_bomp1 = "^${LAYERDIR}/"
BBFILE_PRIORITY_bomp1 = "5"

LAYERVERSION_bomp1 = "1"
LAYERSERIES_COMPAT_bomp1 = "scarthgap"
```

## spectro/mcu/boards/sesimo/bomc1/board.yml
```yaml
board:
  name: sesimo_bomc1
  full_name: SESIMO BOMC1 Spectrometer
  vendor: sesimo
  socs:
  - name: stm32f103xb
```

## spectro/mcu/boards/sesimo/bomc1/sesimo_bomc1_defconfig
```kconfig
CONFIG_PINCTRL=y
CONFIG_SPI=y
CONFIG_GPIO=y

CONFIG_USB_DEVICE_STACK_NEXT=y
CONFIG_USBD_CDC_ACM_CLASS=y

CONFIG_SERIAL=y
CONFIG_UART_LINE_CTRL=y

CONFIG_STDOUT_CONSOLE=y
CONFIG_CONSOLE=y
CONFIG_UART_CONSOLE=y
```

## spectro/mcu/drivers/adc/Kconfig.ads8329
```kconfig
config ADC_ADS8329
    bool
    default y
    depends on DT_HAS_TI_ADS8329_ENABLED
    select SPI
    select GPIO
    select GPIO_ENABLE_DISABLE_INTERRUPT

if ADC_ADS8329

config ADC_ADS8329_THREAD_STACK_SIZE
    int
    default 512

config ADC_ADS8329_THREAD_PRIO
    int
    default 0

endif # ADC_ADS8329
```

## spectro/mcu/drivers/ccd/Kconfig
```kconfig
menuconfig CCD
    bool "CCD detector"
    help
        Enable CCD detector driver(s)

if CCD

rsource "Kconfig.tcd1304"

endif # CCD
```

## spectro/mcu/drivers/light/Kconfig
```kconfig
menuconfig LIGHT
    bool "Light source drivers"
    help
        Include light drivers in system configuration. These are primarily
        used to adjust the spectrometer light source.

if LIGHT

config LIGHT_INIT_PRIORITY
    int
    default 89

rsource "Kconfig.sg90"

endif
```

## spectro/mcu/drivers/light/Kconfig.sg90
```kconfig
config LIGHT_SG90
    bool
    default y
    select PWM
    depends on DT_HAS_SESIMO_SG90_LIGHT_ENABLED
```

## spectro/mcu/drivers/sensor/sesimo/bofp1/Kconfig
```kconfig
config SENSOR_BOFP1
    bool "Enable driver support for BOFP1 driver"
    default y
    depends on DT_HAS_SESIMO_BOFP1_ENABLED
    imply SPI
    imply RTIO
    imply SENSOR_ASYNC_API
    imply SPI_RTIO
```

## spectro/mcu/drivers/sensor/toshiba/tcd1304/Kconfig
```kconfig
config TOSHIBA_TCD1304
    bool
    default y
    depends on DT_HAS_TOSHIBA_TCD1304_ENABLED
    select GPIO
    select ADC
    select SENSOR_ASYNC_API
    select ADC_ASYNC

if TOSHIBA_TCD1304

config TOSHIBA_TCD1304_PWM
    bool "Enable PWM control of clock signals"
    default y
    select PWM

endif # TOSHIBA_TCD1304
```

## spectro/mcu/dts/bindings/adc/ti,ads8329.yaml
```yaml
include: ["adc-controller.yaml", "spi-device.yaml"]

description: |
  Texas Instruments ADS8329

compatible: "ti,ads8329"

properties:
  "#io-channel-cells":
    const: 1

  pwms:
    type: phandle-array

  pwm-names:
    type: string-array

  ready-gpios:
    type: phandle-array

io-channel-cells:
  - channel
```

## spectro/mcu/dts/bindings/ccd/toshiba,tcd1304.yaml
```yaml
include: base.yaml

compatible: toshiba,tcd1304
description: Device driver for the TCD1304 CCD Detector

properties:
  pwms:
    type: phandle-array
    required: false

  pwm-names:
    type: string-array
    required: false

  sampling-rate:
    type: int
    required: false

  gpios:
    type: phandle-array
    required: true

  io-channels:
    required: true
    description: "ADC"
```

## spectro/mcu/dts/bindings/light/sesimo,sg90-light.yaml
```yaml
include: [base.yaml]

compatible: sesimo,sg90-light
description: Device driver for the SG90 driven light source

properties:
  pwms:
    type: phandle-array
    required: true

  pwm-names:
    type: string-array
    required: true

  dc-on:
    type: int
    required: true

  dc-off:
    type: int
    required: true
```

## spectro/mcu/dts/bindings/sensor/sesimo,bofp1.yaml
```yaml
include: [base.yaml, spi-device.yaml]

compatible: sesimo,bofp1
description: Device driver for the SESIMO FPGA CCD Sensor bridge (BOFP1)

properties:
  prescaler:
    type: int
    default: 0
    description: |
      Prescaler for the timing parameters used on the FPGA. Timing parameters
      are calculated as `CLK/((PSC + 1) * DIV)`

  clock-frequency:
    type: int
    default: 100000000
    description: |
      Operating clock frequency (in Hz) for the FPGA. 

  clkdiv:
    type: int
    default: 0
    description: |
      Clock divider value. The master clock frequency for the CCD is given
      by `f = clock-frequency / (25 + 100/7 * clkdiv)`

  integration-time:
    type: int
    default: 20000
    description: |
      Set integration time (in nanoseconds).
```
